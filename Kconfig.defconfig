## Kconfig.defconfig
```kconfig
if SHIELD_SPLIT_TRABOPAT_RIGHT

config ZMK_KEYBOARD_NAME
    default "split_trabopat"

endif

if SHIELD_SPLIT_TRABOPAT_LEFT || SHIELD_SPLIT_TRABOPAT_RIGHT

config ZMK_SPLIT
    default y

endif
```

## Kconfig.shield
```kconfig
config SHIELD_SPLIT_TRABOPAT_LEFT
    def_bool $(shields_list_contains,split_trabopat_left)
config SHIELD_SPLIT_TRABOPAT_RIGHT
    def_bool $(shields_list_contains,split_trabopat_right)
```
